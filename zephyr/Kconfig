## zephyr/Kconfig
```kconfig
config ZEPHYR_CMSIS_DSP_MODULE
	bool

menuconfig CMSIS_DSP
	bool "CMSIS-DSP Library Support"
	help
	  This option enables the CMSIS-DSP library.

if CMSIS_DSP

config CMSIS_DSP_NEON
	bool "Neon Instruction Set"
	default y
	depends on CPU_CORTEX_A
	help
	  This option enables the NEON Advanced SIMD instruction set, which is
	  available on most Cortex-A and some Cortex-R processors.

config CMSIS_DSP_NEON_EXPERIMENTAL
	bool "Neon Instruction Set"
	depends on CPU_CORTEX_A
	help
	  This option enables the NEON Advanced SIMD instruction set, which is
	  available on most Cortex-A and some Cortex-R processors.

comment "Features"

config CMSIS_DSP_LOOPUNROLL
	bool "Loop Unrolling"
    default y
	help
	  This option enables manual loop unrolling in the DSP functions.

config CMSIS_DSP_ROUNDING
	bool "Rounding"
	help
	  This option enables rounding on the support functions.

config CMSIS_DSP_CUSTOM_CONFIG 
    bool "Custom configuration header"
    help 
      This option enables the inclusion of the header 
	  arm_dsp_config.h. This header can be used to
	  define ARM_DSP_ATTRIBUTE and ARM_DSP_TABLE_ATTRIBUTE.
	  ARM_DSP_ATTRIBUTE can be used to define all functions as 
	  weak or put them in specific memory sections.
	  ARM_DSP_TABLE_ATTRIBUTE can be used to put CMSIS DSP tables
	  in specific memory sections.
	  The module's generated arm_dsp_config.h includes this header with
	  #include_next. Add its directory with zephyr_include_directories()
	  and to no target's own include path: a target that has it on its own
	  path finds this header first, skips the generated one, and compiles
	  without the CMSIS-DSP feature definitions of the library. The library
	  itself then fails to compile ("arm_dsp_config.h: No such file or
	  directory"), because the generated header's #include_next finds no
	  user header on the library's include path.

config CMSIS_DSP_MATRIXCHECK
	bool "Matrix Check"
	help
	  This option enables validation of the input and output sizes of
	  matrices.

config CMSIS_DSP_AUTOVECTORIZE
	bool "Auto Vectorize"
	help
	  This option prefers autovectorizable code to one using C intrinsics
	  in the DSP functions.
	  It applies to the CMSIS-DSP library and to every source file that
	  includes its headers, and not to other libraries in the image.
	  A source file that includes arm_math.h before CMSIS-NN or heliaCORE
	  headers also compiles those headers' inline helpers as scalar code;
	  include those headers first, or in separate files. That costs speed
	  and allows the helpers' documented scalar/MVE differences, without
	  any layout or ABI mismatch.

config CMSIS_DSP_FLOAT16
	bool "Half-Precision (16-bit Float) Support"
	default y
	depends on FP16_ARITHMETIC
	help
	  This option enables the half-precision (16-bit) floating-point
	  operations support.
	  It applies to the CMSIS-DSP library and to every source file that
	  includes its headers, and not to other libraries in the image.

config CMSIS_DSP_NE10_DSP_RIFFT_SCALING
	bool "Scaling of RIFFT with Neon"
	default y
	depends on (CMSIS_DSP_NEON || CMSIS_DSP_NEON_EXPERIMENTAL)
	

config CMSIS_DSP_LAX_VECTOR_CONVERSIONS
	bool "Lax Vector Conversions"
	default y
	depends on (ARMV8_1_M_MVEI || ARMV8_1_M_MVEF || CMSIS_DSP_NEON || CMSIS_DSP_NEON_EXPERIMENTAL)
	help
	  This option enables lax vector conversions

endif #CMSIS_DSP
```
